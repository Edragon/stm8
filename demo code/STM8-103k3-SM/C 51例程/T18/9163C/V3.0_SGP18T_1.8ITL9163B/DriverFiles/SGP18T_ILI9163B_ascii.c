#include<reg51.h>
#include "MyType.h"
#include "SGP18T_ILI9163B_config.h"
#include "SGP18T_ILI9163B_ascii.h"
#include "SGP18T_ILI9163B_base.h"


/*--------------------------------------------------------------*/
//字库码的引索
/*
  (0)  !(1)  "(2)  #(3)  $(4)  %(5)  &(6)  '(7)
 ((8)  )(9)  *(10) +(11) ,(12) -(13) .(14) /(15)
 0(16) 1(17) 2(18) 3(19) 4(20) 5(21) 6(22) 7(23)
 8(24) 9(25) :(26) ;(27) <(28) =(29) >(30) ?(31)
 @(32) A(33) B(34) C(35) D(36) E(37) F(38) G(39)
 H(40) I(41) J(42) K(43) L(44) M(45) N(46) O(47)
 P(48) Q(49) R(50) S(51) T(52) U(53) V(54) W(55)
 X(56) Y(57) Z(58) [(59) \(60) ](61) ^(62) _(63)
 `(64) a(65) b(66) c(67) d(68) e(69) f(70) g(71)
 h(72) i(73) j(74) k(75) l(76) m(77) n(78) o(79)
 p(80) q(81) r(82) s(83) t(84) u(85) v(86) w(87)
 x(88) y(89) z(90) {(91) |(92) }(93) ~(94)
/*--------------------------------------------------------------*/


/*--------------------------------------------------------------*/
//	  字体:	8*6字体
//取码规则:	低位在前, 列行扫描, 阴码(1-亮, 0-灭)
//查表方法: 要显示的ASCII码-32就可以得到字库码的指针
unsigned char code Font_code8[][6] = {
{0x00,0x00,0x00,0x00,0x00,0x00},// (0)
{0x00,0x00,0x00,0x4F,0x00,0x00},//!(1)
{0x00,0x00,0x07,0x00,0x07,0x00},//"(2)
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{0x00,0x1C,0x22,0x44,0x22,0x1C}};//爱心(132)



#if  (PRINTCHAR16 == 1)	//字体选择Fixedsys
/*--------------------------------------------------------------*/
//	  字体:	GulimChe12
//取码规则:	高位在前, 行列扫描, 阴码(1-亮, 0-灭)
//查表方法: 要显示的ASCII码-32就可以得到字库码的指针
unsigned char code Font_code16[][16] = {
{0x00,0x00,0x00,0x00,0x00,0x00,0x00,0x00,0x00,0x00,0x00,0x00,0x00,0x00,0x00,0x00},// (0)
{0x00,0x00,0x10,0x10,0x10,0x10,0x10,0x10,0x10,0x10,0x00,0x00,0x10,0x10,0x00,0x00},//!(1)
{0x00,0x00,0x24,0x24,0x24,0x24,0x00,0x00,0x00,0x00,0x00,0x00,0x00,0x00,0x00,0x00},//"(3)
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{0x00,0x00,0x00,0x00,0x00,0x00,0x8C,0x72,0x00,0x00,0x00,0x00,0x00,0x00,0x00,0x00}
};
/*--------------------------------------------------------------*/
#endif

/*--------------------------------------------------------------*/
#if 	(PRINTCHAR16	> 0)	//(8*16字体)
/*--------------------------------------------------------------*/
//液晶字符输出(8*16字体)
//x: 0 -15   (行)
//y: 0 -9  	 (列)
void LCD_printc16(uint8 x, uint8 y, uint8 c_dat,uint16 word_color,uint16 back_color)
{
	uint8 i,j;

	ILI9163B_SetPos(x*8,y*16,(x+1)*8-1,(y+1)*16-1);			//定位字符显示区域

	for(j=0; j <16; j++)
	{
		for(i=0; i<8; i++)
		{
			if((Font_code16[c_dat-32][j]) & (0x01<<i))
				ILI9163B_write_para16(word_color);
			else
				ILI9163B_write_para16(back_color);
		}
	}
}

/*--------------------------------------------------------------*/
//液晶字符串输出(8*16字体)
//x: 0 - 15 (行)
//y: 0 - 9  (列)
void LCD_prints16(uint8 x, uint8 y, uint8 *s_dat,uint16 word_color,uint16 back_color)
{
	while(*s_dat) LCD_printc16(x++, y, *s_dat++,word_color,back_color);
}
/*--------------------------------------------------------------*/
#endif/*16*8字体*/


#if	 (PRINTCHAR6 == 1)
/*--------------------------------------------------------------*/
//液晶字符输出(6*8字体)
//x: 0 - 20	(行)
//y: 0 -19	(列)
void LCD_printc6(uint8 x, uint8 y, uint8 c_dat,uint16 word_color,uint16 back_color)
{
	uint8 i,j;

	ILI9163B_SetPos(x*6,y*8,(x+1)*6-1,(y+1)*8-1);			//定位字符显示区域

	for(j=0; j<8; j++)
	{
		for(i=0; i<6; i++)
		{
			if((Font_code8[c_dat-32][i]) & (0x01<<j))
				ILI9163B_write_para16(word_color);
			else
				ILI9163B_write_para16(back_color);
		}
	}
}

/*--------------------------------------------------------------*/
//液晶字符串输出(6*8字体)
//x: 0 - 20 (行)
//y: 0 -19 (列)
void LCD_prints6(uint8 x, uint8 y, uint8 *s_dat,uint16 word_color,uint16 back_color)
{
	while(*s_dat) LCD_printc6(x++, y, *s_dat++,word_color,back_color);
}

/*--------------------------------------------------------------*/ 
//定位输出数字
//x: 0 - 20  (行)
//y: 0 - 19 (列)
//num: 0 - 65535	要显示的数字
//num_bit: 0 - 5	数字的位数
void LCD_printn6(uint8 x, uint8 y, uint16 num, uint8 num_bit,uint16 word_color,uint16 back_color)
{
	char i;
	uint8 ii;
	uint8 dat[6];
	for(i = 0; i < 6; i++) dat[i] = 0; i = 0;	//初始化数据
	while(num / 10)								//拆位
	{
		dat[i] = num % 10;						//最低位
		num /= 10; i++;		
	}
	dat[i] = num;								//最高位
	ii = i;										//保存dat的位数
	for(; i >= 0; i--)	dat[i] += 48;			//转化成ASCII
	for(i = 0; i < num_bit; i++)
	LCD_printc6(x, y + i, ' ',word_color,back_color);		//清显示区域
	for(i = ii; i >= 0; i--)
	LCD_printc6(x++, y, dat[i],word_color,back_color);		//输出数值
}
/*--------------------------------------------------------------*/
#endif/*8*6字体选择*/


#if	 (PRINTCHAR8 == 1)
/*--------------------------------------------------------------*/
//液晶字符输出(8*8字体)
//x: 0 - 15	(行)
//y: 0 -19	(列)
void LCD_printc(uint8 x, uint8 y, uint8 c_dat,uint16 word_color,uint16 back_color)
{
	uint8 i,j;

	ILI9163B_SetPos(x*8,y*8,(x+1)*8-1,(y+1)*8-1);			//定位字符显示区域

	for(j=0; j<8; j++)
	{
		ILI9163B_write_para16(back_color);
		for(i=0; i<6; i++)
		{
			if((Font_code8[c_dat-32][i]) & (0x01<<j))
				ILI9163B_write_para16(word_color);
			else
				ILI9163B_write_para16(back_color);
		}
		ILI9163B_write_para16(back_color);
	}
}

/*--------------------------------------------------------------*/
//液晶字符串输出(8*8字体)
//x: 0 - 15 (行)
//y: 0 -19 (列)
void LCD_prints(uint8 x, uint8 y, uint8 *s_dat,uint16 word_color,uint16 back_color)
{
	while(*s_dat) LCD_printc(x++, y, *s_dat++,word_color,back_color);
}

/*--------------------------------------------------------------*/ 
//定位输出数字
//x: 0 - 15  (行)
//y: 0 - 19 (列)
//num: 0 - 65535	要显示的数字
//num_bit: 0 - 5	数字的位数
void LCD_printn(uint8 x, uint8 y, uint16 num, uint8 num_bit,uint16 word_color,uint16 back_color)
{
	char i;
	uint8 ii;
	uint8 dat[6];
	for(i = 0; i < 6; i++) dat[i] = 0; i = 0;	//初始化数据
	while(num / 10)								//拆位
	{
		dat[i] = num % 10;						//最低位
		num /= 10; i++;		
	}
	dat[i] = num;								//最高位
	ii = i;										//保存dat的位数
	for(; i >= 0; i--)	dat[i] += 48;			//转化成ASCII
	for(i = 0; i < num_bit; i++)
	LCD_printc(x, y + i, ' ',word_color,back_color);					//清显示区域
	for(i = ii; i >= 0; i--)
	LCD_printc(x, y++, dat[i],word_color,back_color);					//输出数值
}
#endif /*8*8字体选择*/
